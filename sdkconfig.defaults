## sdkconfig.defaults
```kconfig
CONFIG_ESP_WIFI_SOFTAP_SUPPORT=n

# OTA Configuration
CONFIG_PARTITION_TABLE_CUSTOM=y
CONFIG_PARTITION_TABLE_CUSTOM_FILENAME="16m.csv"
CONFIG_PARTITION_TABLE_FILENAME="16m.csv"
CONFIG_PARTITION_TABLE_OFFSET=0x8000
```
